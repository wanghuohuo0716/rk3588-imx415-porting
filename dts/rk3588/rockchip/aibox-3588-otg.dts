// SPDX-License-Identifier: (GPL-2.0+ OR MIT)
/*
 * Copyright (c) 2021 Rockchip Electronics Co., Ltd.
 *
 */

/dts-v1/;

#include "aibox-3588-otg.dtsi"

/ {
	model = "Firefly AIBOX-3588";
	compatible = "rockchip,aibox-3588", "rockchip,rk3588";
};

