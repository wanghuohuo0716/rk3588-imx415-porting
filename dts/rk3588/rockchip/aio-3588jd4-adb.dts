// SPDX-License-Identifier: (GPL-2.0+ OR MIT)
/*
 * Copyright (c) 2021 Rockchip Electronics Co., Ltd.
 *
 */

/dts-v1/;

#include "aio-3588jd4-host.dtsi"

//down
&usbdrd_dwc3_0{
	dr_mode = "peripheral";
    status = "okay";
};
