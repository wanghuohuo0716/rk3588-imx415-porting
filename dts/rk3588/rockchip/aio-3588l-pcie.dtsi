// SPDX-License-Identifier: (GPL-2.0+ OR MIT)
/*
 * Copyright (c) 2021 Rockchip Electronics Co., Ltd.
 *
 */

&sata0 {
    status = "disabled";
};
//pcie@fe190000
&pcie2x1l2 {
    reset-gpios = <&gpio4 RK_PA2 GPIO_ACTIVE_HIGH>;
    vpcie3v3-supply = <&vcc_sata_pwr_en>;
    status = "okay";
};